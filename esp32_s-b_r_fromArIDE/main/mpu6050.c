#include "mpu6050.h"
#include <string.h>
#include <stdlib.h>
#include "esp_log.h"
#include "driver/i2c.h"
#include <math.h>
#include "freertos/FreeRTOS.h"
#include "freertos/task.h"
#include "freertos/queue.h"
#include "driver/gpio.h"
#include "i2c_com.h"

#define TAG "MPU_DMP"
#define MPU_INT 4
#define MPU6050_DMP_PACKET_SIZE  42

// used MPU6050 registers
#define XG_OFFS_TC_REG           0x00
#define ZA_OFFS_H_REG            0x06
#define XG_OFFS_USRH_REG         0x13
#define YG_OFFS_USRH_REG         0x15
#define ZG_OFFS_USRH_REG         0x17
#define SMPLRT_DIV_REG           0x19
#define CONFIG_REG               0x1A
#define GYRO_CONFIG_REG          0x1B
#define ACCEL_CONFIG_REG         0x1C
#define MOT_THR_REG              0x1F
#define ZRMOT_THR_REG            0x20
#define MOT_DUR_REG              0x21
#define ZRMOT_DUR_REG            0x22
#define MPU6050_INT_ENABLE_REG   0x38
#define INT_STATUS_REG           0x3A
#define ACCEL_START_REG          0x3B
#define GYRO_START_REG           0x43
#define USER_CTRL_REG            0x6A
#define PWR_MGMT_1_REG           0x6B
#define BANK_SEL_REG             0x6D
#define MEM_START_ADDR_REG       0x6E
#define MEM_R_W_REG              0x6F
#define DMP_CFG_1_REG            0x70
#define DMP_CFG_2_REG            0x71
#define FIFO_COUNT_REG           0x72
#define FIFO_R_W_REG             0x74
#define WHO_AM_I_REG             0x75

#define CLOCK_PLL_ZGYRO         0x03
#define GYRO_FS_250         0x00
#define ACCEL_FS_2          0x00

#ifndef DMP_FIFO_RATE_DIVISOR 
#define DMP_FIFO_RATE_DIVISOR 0x01 // The New instance of the Firmware has this as the default
#endif

#define DMP_MEMORY_CHUNK_SIZE 16

#define DLPF_BW_42       0x03  // DLPF setting for ~42 Hz bandwidth
#define GYRO_FS_2000     0x03  // Gyro full-scale range = ±2000 °/s
#define EXT_SYNC_TEMP_OUT_L 0x02

#ifndef M_PI
#define M_PI 3.14159265358979323846
#endif

#define MPU6050_DMP_CODE_SIZE 1929
extern void mpu_isr_handler(void *arg);

static const uint8_t dmpMemory[MPU6050_DMP_CODE_SIZE] = {
	/* bank # 0 */
	0xFB, 0x00, 0x00, 0x3E, 0x00, 0x0B, 0x00, 0x36, 0x00, 0x01, 0x00, 0x02, 0x00, 0x03, 0x00, 0x00,
	0x00, 0x65, 0x00, 0x54, 0xFF, 0xEF, 0x00, 0x00, 0xFA, 0x80, 0x00, 0x0B, 0x12, 0x82, 0x00, 0x01,
	0x00, 0x02, 0x00, 0x00, 0x00, 0x00, 0x00, 0x00, 0x00, 0x00, 0x00, 0x00, 0x00, 0x00, 0x00, 0x00,
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	0xFF, 0xE6, 0x80, 0x79, 0x02, 0x00, 0x00, 0x00, 0x00, 0x00, 0xD0, 0xD6, 0x00, 0x00, 0x27, 0x10,
	/* bank # 1 */
	0xFB, 0x00, 0x00, 0x00, 0x40, 0x00, 0x00, 0x00, 0x00, 0x00, 0x00, 0x00, 0x00, 0x00, 0x00, 0x00,
	0x00, 0x00, 0x00, 0x01, 0x00, 0x00, 0x00, 0x00, 0x00, 0x00, 0x01, 0x00, 0x01, 0x00, 0x00, 0x00,
	0x00, 0x00, 0xFA, 0x36, 0xFF, 0xBC, 0x30, 0x8E, 0x00, 0x05, 0xFB, 0xF0, 0xFF, 0xD9, 0x5B, 0xC8,
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	0x00, 0x00, 0x25, 0x4D, 0x00, 0x2F, 0x70, 0x6D, 0x00, 0x00, 0x05, 0xAE, 0x00, 0x0C, 0x02, 0xD0,
	/* bank # 2 */
	0x00, 0x00, 0x00, 0x00, 0x00, 0x65, 0x00, 0x54, 0xFF, 0xEF, 0x00, 0x00, 0x00, 0x00, 0x00, 0x00,
	0x00, 0x00, 0x01, 0x00, 0x00, 0x44, 0x00, 0x01, 0x00, 0x05, 0x8B, 0xC1, 0x00, 0x00, 0x01, 0x00,
	0x00, 0x00, 0x00, 0x00, 0x00, 0x65, 0x00, 0x00, 0x00, 0x54, 0x00, 0x00, 0xFF, 0xEF, 0x00, 0x00,
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	0x00, 0x00, 0x00, 0x00, 0x00, 0x00, 0x00, 0x00, 0x00, 0x00, 0x00, 0x00, 0x00, 0x00, 0x00, 0x00,
	/* bank # 3 */
	0xD8, 0xDC, 0xBA, 0xA2, 0xF1, 0xDE, 0xB2, 0xB8, 0xB4, 0xA8, 0x81, 0x91, 0xF7, 0x4A, 0x90, 0x7F,
	0x91, 0x6A, 0xF3, 0xF9, 0xDB, 0xA8, 0xF9, 0xB0, 0xBA, 0xA0, 0x80, 0xF2, 0xCE, 0x81, 0xF3, 0xC2,
	0xF1, 0xC1, 0xF2, 0xC3, 0xF3, 0xCC, 0xA2, 0xB2, 0x80, 0xF1, 0xC6, 0xD8, 0x80, 0xBA, 0xA7, 0xDF,
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	0xB8, 0xA2, 0xDF, 0xDF, 0xDF, 0xA3, 0xDF, 0xDF, 0xDF, 0xD8, 0xD8, 0xF1, 0xB8, 0xA8, 0xB2, 0x86,
	/* bank # 4 */
	0xB4, 0x98, 0x0D, 0x35, 0x5D, 0xB8, 0xAA, 0x98, 0xB0, 0x87, 0x2D, 0x35, 0x3D, 0xB2, 0xB6, 0xBA,
	0xAF, 0x8C, 0x96, 0x19, 0x8F, 0x9F, 0xA7, 0x0E, 0x16, 0x1E, 0xB4, 0x9A, 0xB8, 0xAA, 0x87, 0x2C,
	0x54, 0x7C, 0xB9, 0xA3, 0xDE, 0xDF, 0xDF, 0xA3, 0xB1, 0x80, 0xF2, 0xC4, 0xCD, 0xC9, 0xF1, 0xB8,
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	0xC8, 0x9F, 0x12, 0x9E, 0xF3, 0x15, 0xA8, 0xDA, 0x12, 0x10, 0xD8, 0xF1, 0xAF, 0xC8, 0x97, 0x87,
	/* bank # 5 */
	0x34, 0xB5, 0xB9, 0x94, 0xA4, 0x21, 0xF3, 0xD9, 0x22, 0xD8, 0xF2, 0x2D, 0xF3, 0xD9, 0x2A, 0xD8,
	0xF2, 0x35, 0xF3, 0xD9, 0x32, 0xD8, 0x81, 0xA4, 0x60, 0x60, 0x61, 0xD9, 0x61, 0xD8, 0x6C, 0x68,
	0x69, 0xD9, 0x69, 0xD8, 0x74, 0x70, 0x71, 0xD9, 0x71, 0xD8, 0xB1, 0xA3, 0x84, 0x19, 0x3D, 0x5D,
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	0x8A, 0x64, 0x48, 0x31, 0x8B, 0x30, 0x49, 0x60, 0xA5, 0x88, 0x20, 0x09, 0x71, 0x58, 0x44, 0x68,
	/* bank # 6 */
	0x11, 0x39, 0x64, 0x49, 0x30, 0x19, 0xF1, 0xAC, 0x00, 0x2C, 0x54, 0x7C, 0xF0, 0x8C, 0xA8, 0x04,
	0x28, 0x50, 0x78, 0xF1, 0x88, 0x97, 0x26, 0xA8, 0x59, 0x98, 0xAC, 0x8C, 0x02, 0x26, 0x46, 0x66,
	0xF0, 0x89, 0x9C, 0xA8, 0x29, 0x51, 0x79, 0x24, 0x70, 0x59, 0x44, 0x69, 0x38, 0x64, 0x48, 0x31,
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	0xAC, 0x91, 0x2C, 0x4C, 0x6C, 0x8A, 0x9B, 0x2D, 0xD9, 0xD8, 0xD8, 0x51, 0xD9, 0xD8, 0xD8, 0x79,
	/* bank # 7 */
	0xD9, 0xD8, 0xD8, 0xF1, 0x9E, 0x88, 0xA3, 0x31, 0xDA, 0xD8, 0xD8, 0x91, 0x2D, 0xD9, 0x28, 0xD8,
	0x4D, 0xD9, 0x48, 0xD8, 0x6D, 0xD9, 0x68, 0xD8, 0xB1, 0x83, 0x93, 0x35, 0x3D, 0x80, 0x25, 0xDA,
	0xD8, 0xD8, 0x85, 0x69, 0xDA, 0xD8, 0xD8, 0xB4, 0x93, 0x81, 0xA3, 0x28, 0x34, 0x3C, 0xF3, 0xAB,
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	0xB9, 0xA7, 0xF1, 0x26, 0x26, 0x26, 0xFE, 0xD8, 0xFF,

};

esp_err_t mpu6050_init(void)
{
    esp_err_t ret;
    ESP_LOGI(TAG, "Resetting MPU6050...");
    ret = mpu6050_reset();
    if (ret != ESP_OK) return ret;
    vTaskDelay(pdMS_TO_TICKS(30));

    ret = mpu6050_set_sleep_enabled(false);
    if (ret != ESP_OK) return ret;

    ret = mpu6050_set_clock_source(CLOCK_PLL_ZGYRO);
    if (ret != ESP_OK) return ret;
    ret = mpu6050_set_gyro_range(GYRO_FS_250);
    if (ret != ESP_OK) return ret;
    ret = mpu6050_set_accel_range(ACCEL_FS_2);
    if (ret != ESP_OK) return ret;
    return ESP_OK;
}

esp_err_t mpu6050_dmp_initialize(void)
{
    esp_err_t ret;

    ret = mpu6050_set_FIFO_oflow_int_enabled(true);
    if (ret != ESP_OK) return ret;

    ret = mpu6050_set_DMP_int_enabled(true);
    if (ret != ESP_OK) return ret;

    ret = mpu6050_set_external_frame_sync(EXT_SYNC_TEMP_OUT_L);
    if (ret != ESP_OK) return ret;

    ret = mpu6050_set_dlpf_mode(DLPF_BW_42);
    if (ret != ESP_OK) return ret;

    // (1kHz / (1 + 4) = 200Hz)
    ret = mpu6050_set_sample_rate(4);
    if (ret != ESP_OK) return ret;

    ret = mpu6050_set_gyro_range(GYRO_FS_2000);
    if (ret != ESP_OK) return ret;

    ESP_LOGI(TAG, "Loading DMP firmware...");
    ret = mpu6050_write_prog_memory_block(dmpMemory, MPU6050_DMP_CODE_SIZE, 0, 0);
    if (ret != ESP_OK) return ret;


    ESP_LOGI(TAG, "Configuring DMP and motion detection...");
    uint8_t dmp_update[] = {0x00, DMP_FIFO_RATE_DIVISOR};
    mpu6050_write_prog_memory_block(dmp_update, 2, 0x02, 0x16);

    ret = mpu6050_set_dmp_config1(0x03);
    if (ret != ESP_OK) return ret;

    ret = mpu6050_set_dmp_config2(0x00);
    if (ret != ESP_OK) return ret;

    ret = mpu6050_set_otp_bank_valid(false);
    if (ret != ESP_OK) return ret;

    ret = mpu6050_set_motion_detection_threshold(2);
    if (ret != ESP_OK) return ret;

    ret = mpu6050_set_zero_motion_detection_threshold(156);
    if (ret != ESP_OK) return ret;

    ret = mpu6050_set_motion_detection_duration(80);
    if (ret != ESP_OK) return ret;

    ret = mpu6050_set_zero_motion_detection_duration(0);
    if (ret != ESP_OK) return ret;

    ret = mpu6050_set_fifo_enabled(true);
    if (ret != ESP_OK) return ret;

    ret = mpu6050_reset_dmp();
    if (ret != ESP_OK) return ret;

    ret = mpu6050_set_dmp_enabled(false);
    if (ret != ESP_OK) return ret;

    ret = mpu6050_reset_fifo();
    if (ret != ESP_OK) return ret;

    ESP_LOGI(TAG, "Reading INT STATUS");
    uint8_t int_status;
    mpu6050_get_int_status(&int_status);
    ESP_LOGI(TAG, "INT STATUS: 0x%02X", int_status);

    return ESP_OK;
}

esp_err_t mpu6050_get_who_am_i(uint8_t *who_am_i)
{
    return i2c_com_read_register(WHO_AM_I_REG, who_am_i);
}

esp_err_t mpu6050_set_sleep_enabled(bool enabled)
{
    return i2c_com_write_bit(PWR_MGMT_1_REG, 6, enabled);
}

esp_err_t mpu6050_set_clock_source(uint8_t source)
{
    return i2c_com_write_bits(PWR_MGMT_1_REG, 2, 3, source);
}

esp_err_t mpu6050_set_FIFO_oflow_int_enabled(bool enabled)
{
    return i2c_com_write_bit(MPU6050_INT_ENABLE_REG,4, enabled);
}

esp_err_t mpu6050_set_DMP_int_enabled(bool enabled)
{
    return i2c_com_write_bit(MPU6050_INT_ENABLE_REG,1, enabled);
}

esp_err_t mpu6050_set_sample_rate(uint8_t rate)
{
    return i2c_com_write_register(SMPLRT_DIV_REG, rate);
}

esp_err_t mpu6050_set_external_frame_sync(uint8_t sync)
{
    return i2c_com_write_bits(CONFIG_REG, 5, 3, sync);
}

esp_err_t mpu6050_set_dlpf_mode(uint8_t mode)
{
    return i2c_com_write_bits(CONFIG_REG, 2, 3, mode);
}

esp_err_t mpu6050_set_gyro_range(uint8_t range)
{
    return i2c_com_write_bits(GYRO_CONFIG_REG, 4, 2, range);
}

esp_err_t mpu6050_set_accel_range(uint8_t range)
{

    return i2c_com_write_bits(ACCEL_CONFIG_REG, 4, 2, range);
}

esp_err_t mpu6050_set_fifo_enabled(bool enabled)
{
    return i2c_com_write_bit(USER_CTRL_REG, 6, enabled);
}

esp_err_t mpu6050_reset()
{
    return i2c_com_write_bit(PWR_MGMT_1_REG, 7, true);
}

esp_err_t mpu6050_reset_fifo()
{
    return i2c_com_write_bit(USER_CTRL_REG, 2, true);
}

esp_err_t mpu6050_reset_dmp()
{
    return i2c_com_write_bit(USER_CTRL_REG, 3, true);
}

esp_err_t mpu6050_set_dmp_enabled(bool enabled)
{
    return i2c_com_write_bit(USER_CTRL_REG, 7, enabled);
}

esp_err_t mpu6050_set_dmp_config1(uint8_t config) {
    return i2c_com_write_register(DMP_CFG_1_REG, config);
}

esp_err_t mpu6050_set_dmp_config2(uint8_t config) {
    return i2c_com_write_register(DMP_CFG_2_REG, config);
}

esp_err_t mpu6050_set_otp_bank_valid(bool enabled) {
    return i2c_com_write_bit(XG_OFFS_TC_REG, 7, enabled);
}

esp_err_t mpu6050_set_motion_detection_threshold(uint8_t threshold) {
    return i2c_com_write_register(MOT_THR_REG, threshold);
}

esp_err_t mpu6050_set_zero_motion_detection_threshold(uint8_t threshold) {
    return i2c_com_write_register(ZRMOT_THR_REG, threshold);
}

esp_err_t mpu6050_set_motion_detection_duration(uint8_t duration) {
    return i2c_com_write_register(MOT_DUR_REG, duration);
}

esp_err_t mpu6050_set_zero_motion_detection_duration(uint8_t duration) {
    return i2c_com_write_register(ZRMOT_DUR_REG, duration);
}

esp_err_t mpu6050_interrupt_init()
{
    gpio_config_t io_conf = {
        .intr_type = GPIO_INTR_POSEDGE,
        .mode = GPIO_MODE_INPUT,
        .pin_bit_mask = (1ULL << MPU_INT),
        .pull_up_en = GPIO_PULLUP_ENABLE,
        .pull_down_en = GPIO_PULLDOWN_DISABLE
    };
    esp_err_t ret = gpio_config(&io_conf);
    if (ret != ESP_OK) return ret;

    ret = gpio_install_isr_service(0);
    if (ret != ESP_OK && ret != ESP_ERR_INVALID_STATE) return ret; 
    
    ret = gpio_isr_handler_add(MPU_INT, mpu_isr_handler, NULL);
    return ret;
}

esp_err_t mpu6050_get_int_status(uint8_t *status)
{
    return i2c_com_read_register(INT_STATUS_REG, status);
}

uint16_t mpu6050_get_fifo_packet_size(void)
{
    return MPU6050_DMP_PACKET_SIZE;
}

esp_err_t mpu6050_get_fifo_count(uint16_t *count)
{
    uint8_t buff[2];
    esp_err_t ret = i2c_com_read_bytes(FIFO_COUNT_REG, buff, 2);
    if (ret == ESP_OK) {
        *count = (buff[0] << 8) | buff[1];
    }
    return ret;
}

esp_err_t mpu6050_read_fifo(uint8_t *buf, uint16_t len)
{
    esp_err_t ret = i2c_com_read_bytes(FIFO_R_W_REG, buf, len);
    if (ret == ESP_OK) {
        ESP_LOGD(TAG, "mpu6050_read_fifo success, len=%u", len);
    } else {
        ESP_LOGE(TAG, "mpu6050_read_fifo failed: 0x%02x", ret);
    }
    return ret;
}

esp_err_t mpu6050_set_x_gyro_offset(int16_t offset)
{
    return i2c_com_write_word(XG_OFFS_USRH_REG, offset);
}

esp_err_t mpu6050_set_y_gyro_offset(int16_t offset)
{
    return i2c_com_write_word(YG_OFFS_USRH_REG, offset);
}

esp_err_t mpu6050_set_z_gyro_offset(int16_t offset)
{
    return i2c_com_write_word(ZG_OFFS_USRH_REG, offset);
}


esp_err_t mpu6050_set_z_accel_offset(int16_t offset)
{
    uint8_t dev_id;
    esp_err_t ret = i2c_com_read_register(0x75, &dev_id);
    if (ret != ESP_OK) return ret;

    uint8_t save_addr = (dev_id < 0x38) ? ZA_OFFS_H_REG : 0x7D;

    return i2c_com_write_word(save_addr, offset);
}

esp_err_t getFIFOBytes(uint8_t *data, uint8_t length) {
    if(length > 0){
        esp_err_t ret = i2c_com_read_bytes(FIFO_R_W_REG, data, length);
        if (ret == ESP_OK) {
            ESP_LOGD(TAG, "getFIFOBytes read %u bytes", length);
        } else {
            ESP_LOGE(TAG, "getFIFOBytes failed: 0x%02x", ret);
        }
        return ret;
    }
    return ESP_ERR_INVALID_ARG;
}

static esp_err_t mpu6050_set_memory_bank(uint8_t bank, bool prefetch_enabled, bool user_bank)
{
    bank &= 0x1F;
    if (user_bank) bank |= 0x20;
    if (prefetch_enabled) bank |= 0x40;
    return i2c_com_write_register(BANK_SEL_REG, bank);
}

static esp_err_t mpu6050_set_memory_start_address(uint8_t address)
{
    return i2c_com_write_register(MEM_START_ADDR_REG, address);
}

/**
 * @brief Write a large block of data to MPU memory banks
 *
 * @param data pointer to data to write
 * @param data_size total number of bytes to write
 * @param bank starting memory bank (usually 0)
 * @param address starting address within bank (usually 0)
 * @return esp_err_t ESP_OK on success, or I2C error
 */
esp_err_t mpu6050_write_prog_memory_block(const uint8_t *data, uint16_t data_size, uint8_t bank, uint8_t address)
{
    esp_err_t ret;
    uint8_t chunk_size;
    uint16_t i = 0;

    ret = mpu6050_set_memory_bank(bank, false, false);
    if (ret != ESP_OK) return ret;
    ret = mpu6050_set_memory_start_address(address);
    if (ret != ESP_OK) return ret;

    while (i < data_size)
    {
        chunk_size = DMP_MEMORY_CHUNK_SIZE;

        if (i + chunk_size > data_size)
            chunk_size = data_size - i;

        if (chunk_size > (256 - address))
            chunk_size = 256 - address;

        ret = i2c_com_write_bytes(MEM_R_W_REG, &data[i], chunk_size);
        if (ret != ESP_OK) {
            ESP_LOGE(TAG, "Failed writing memory chunk (bank %u, address %u, size %u)", bank, address, chunk_size);
            return ret;
        }

        i += chunk_size;
        address += chunk_size;

        if (i < data_size) {
            if (address == 0) bank++;
            ret = mpu6050_set_memory_bank(bank, false, false);
            if (ret != ESP_OK) return ret;
            ret = mpu6050_set_memory_start_address(address);
            if (ret != ESP_OK) return ret;
        }
    }

    return ESP_OK;
}

int mpu6050_parse_fifo_packet(const uint8_t *fifoBuffer, Quaternion *q, VectorFloat *gravity, float ypr[3]) {
    if (!fifoBuffer || !q || !gravity || !ypr) return -1;

    int16_t qI[4];
    qI[0] = (int16_t)((fifoBuffer[0] << 8) | fifoBuffer[1]);
    qI[1] = (int16_t)((fifoBuffer[4] << 8) | fifoBuffer[5]);
    qI[2] = (int16_t)((fifoBuffer[8] << 8) | fifoBuffer[9]);
    qI[3] = (int16_t)((fifoBuffer[12] << 8) | fifoBuffer[13]);

    q->w = (float)qI[0] / pow(2, 14);
    q->x = (float)qI[1] / pow(2, 14);
    q->y = (float)qI[2] / pow(2, 14);
    q->z = (float)qI[3] / pow(2, 14);

    gravity->x = 2.0f * (q->x * q->z - q->w * q->y);
    gravity->y = 2.0f * (q->w * q->x + q->y * q->z);
    gravity->z = q->w * q->w - q->x * q->x - q->y * q->y + q->z * q->z;

    ypr[0] = atan2f(2.0f * (q->x * q->y - q->w * q->z), 2.0f * (q->w * q->w + q->x * q->x) - 1.0f);
    ypr[1] = atan2f(gravity->x, sqrtf(gravity->y * gravity->y + gravity->z * gravity->z));
    ypr[2] = atan2f(gravity->y, gravity->z);

    if (gravity->z < 0) {
        if (ypr[1] > 0) {
            ypr[1] = M_PI - ypr[1];
        } else {
            ypr[1] = -M_PI - ypr[1];
        }
    }

    return 0;
}